## components/gpsp_core/Kconfig
```kconfig
menu "gpSP GBA Emulator"

    config GPSP_DYNAREC
        bool "Enable Dynamic Recompilation (Dynarec)"
        default n
        help
            Enable ARM→RISC-V dynamic recompilation for higher performance.
            Requires executable PSRAM regions. Disable this for interpreter-only mode.

    config GPSP_SMALL_TRANSLATION_CACHE
        bool "Use small translation cache"
        default y
        depends on GPSP_DYNAREC
        help
            Use smaller JIT code caches (2MB ROM / 384KB RAM instead of 10MB/512KB).
            Recommended for ESP32-P4 to conserve PSRAM.

    config GPSP_ROM_HOT_ZONE
        bool "Enable ROM hot zone (survives cache flush)"
        default y
        depends on GPSP_DYNAREC && GPSP_SMALL_TRANSLATION_CACHE
        help
            Reserve 256KB of extra PSRAM as a hot zone at the start of the
            ROM translation cache.  When a full flush occurs, recent hot PCs
            are re-translated into this zone so that frequently-used blocks
            survive the flush and reduce re-translation stutter.

    config GPSP_ROM_BUFFER_SIZE
        int "ROM buffer size (MB)"
        default 32
        range 1 32
        help
            Maximum ROM buffer size in megabytes.
            Allocation is graceful: if PSRAM is insufficient, fewer blocks are allocated
            and the LRU paging mechanism loads remaining pages from SD on demand.
            With 32MB PSRAM, set to 32 to cache most ROMs entirely.

    config GPSP_CPU_PROFILE_STATS
        bool "Enable CPU profile statistics"
        default n
        help
            Collect per-frame cycle counts for the CPU execution core,
            video renderer, sound mixer, and other subsystems.
            Results are printed to the log once per second.
            Adds a small overhead to every measured scope.

    config GPSP_HAVE_ZBB
        bool "Enable RISC-V Zbb extension"
        default n
        depends on IDF_TARGET_ESP32P4
        help
            Use RISC-V Zbb (basic bit-manipulation) instructions such as
            rev8, clz, min/max, andn, ror, etc. in both compiler output and
            JIT-emitted code. WARNING: ESP32-P4 silicon tested as of 2026-04
            does NOT support Zbb despite the TRM claiming Zb support.
            Enable only if your hardware revision actually executes Zbb
            instructions without Illegal Instruction exceptions.

    config GPSP_P4_SIMD_PIXEL_OPS
        bool "Enable ESP32-P4 PIE pixel ops"
        default n
        depends on IDF_TARGET_ESP32P4
        help
            Enable ESP32-P4 PIE (Processor Instruction Extensions) helpers for
            simple pixel-processing loops in the video renderer.

            This does not replace the GBA PPU renderer with hardware logic.
            Instead it enables selected PIE-backed helpers for simple linear
            post-processing paths such as repeated pixel fills.

            This option is experimental. It uses inline assembly with ESP32-P4
            PIE instructions and should be validated with visual testing and
            frame-time profiling on target hardware.

endmenu
```

## esp32c6_bridge/sdkconfig.defaults
```kconfig
CONFIG_ESPTOOLPY_FLASHSIZE_4MB=y
CONFIG_PARTITION_TABLE_CUSTOM_FILENAME="../managed_components/espressif__esp_hosted/slave/partitions.esp32c6.csv"
CONFIG_ESP_HOST_DEV_BOARD_P4_C6_CORE=y
CONFIG_ESP_SDIO_HOST_INTERFACE=y
CONFIG_ESP_HOSTED_COPROCESSOR_APP_MAIN=y
CONFIG_ESP_HOSTED_ENABLE_PEER_DATA_TRANSFER=y
```

## main/Kconfig.projbuild
```kconfig
menu "gpSP ESP32-P4 Platform (JC4880P443C_I_W)"

    menu "Display"
        config GPSP_LCD_H_RES
            int "LCD horizontal resolution"
            default 480
            help
                Horizontal resolution of the ST7701 panel (480 for JC4880).

        config GPSP_LCD_V_RES
            int "LCD vertical resolution"
            default 800
            help
                Vertical resolution of the ST7701 panel (800 for JC4880).

        config GPSP_USE_PPA_SCALING
            bool "Use PPA hardware scaling"
            default y
            help
                Use the Pixel Processing Accelerator to scale the GBA
                framebuffer (240x160) to LCD resolution.

        config GPSP_NUM_FB
            int "Number of DPI framebuffers (1-3)"
            default 2
            range 1 3
            help
                Number of DPI framebuffers. 2 enables double buffering,
                3 enables triple buffering for jitter-free display.

        config GPSP_LCD_BRIGHTNESS
            int "Default backlight brightness (%)"
            default 80
            range 0 100
            help
                Initial LCD backlight brightness percentage.
    endmenu

    menu "Audio (ES8311 Codec)"
        config GPSP_AUDIO_SAMPLE_RATE
            int "Audio sample rate (Hz)"
            default 65536
            range 32000 96000
            help
                gpsp core currently produces 16-bit stereo PCM at 65536 Hz.
                The ESP32-P4 port feeds the codec at that native rate, so
                values other than 65536 are currently ignored unless a
                resampler is added.

        config GPSP_AUDIO_VOLUME
            int "Default volume (%)"
            default 70
            range 0 100
            help
                Initial speaker volume percentage.
    endmenu

    menu "Input (GPIO buttons)"
        comment "JC4880 has S1-S4 onboard + JP1 expansion connector."
        comment "Use expansion pins (GPIO28-35, GPIO49-52) for external buttons."
        comment "Set to -1 to disable a button."

        config GPSP_GPIO_A
            int "Button A GPIO"
            default -1
        config GPSP_GPIO_B
            int "Button B GPIO"
            default -1
        config GPSP_GPIO_SELECT
            int "Button SELECT GPIO"
            default -1
        config GPSP_GPIO_START
            int "Button START GPIO"
            default -1
        config GPSP_GPIO_RIGHT
            int "D-pad RIGHT GPIO"
            default -1
        config GPSP_GPIO_LEFT
            int "D-pad LEFT GPIO"
            default -1
        config GPSP_GPIO_UP
            int "D-pad UP GPIO"
            default -1
        config GPSP_GPIO_DOWN
            int "D-pad DOWN GPIO"
            default -1
        config GPSP_GPIO_R
            int "Button R GPIO"
            default -1
        config GPSP_GPIO_L
            int "Button L GPIO"
            default -1
    endmenu

    config GPSP_ROM_PATH
        string "Default ROM file path"
        default "/sdcard/game.gba"
        help
            Path to the GBA ROM file to load on startup.

    config GPSP_EMULATION_CORE
        int "Emulation core (0=Core0, 1=Core1)"
        default 1
        range 0 1
        help
            CPU core to run the GBA emulation loop on.
            Core 1 recommended to keep Core 0 for system tasks.

    config GPSP_EMU_TASK_STACK_SIZE
        int "Emulation task stack size (bytes)"
        default 32768
        help
            Stack size for the main emulation task.

    menu "ESP32-C6 Remote Connectivity"
        config GPSP_ENABLE_C6_REMOTE
            bool "Enable ESP32-C6 remote link bring-up"
            default n
            help
                Initialize the P4-side remote Wi-Fi stack through esp_wifi_remote.
                This validates host-to-slave communication by initializing
                ESP-Hosted, reading the slave firmware version, bringing up a
                station interface, and performing a Wi-Fi scan.
                The vendor example uses esp_hosted over SDIO with P4 GPIO18/19
                and GPIO14-17, plus GPIO54 as the C6 reset line.

        config GPSP_C6_SCAN_LIST_SIZE
            int "ESP32-C6 scan result log limit"
            default 10
            range 1 32
            depends on GPSP_ENABLE_C6_REMOTE
            help
                Maximum number of scanned access points to log during the
                hosted Wi-Fi smoke test.

        config GPSP_C6_CONNECT_TEST
            bool "Run hosted STA connect smoke test"
            default n
            depends on GPSP_ENABLE_C6_REMOTE
            help
                After the remote scan succeeds, try connecting the remote C6
                station to the SSID configured below and wait for an IP.

        config GPSP_C6_CONNECT_SSID
            string "Hosted STA test SSID"
            default ""
            depends on GPSP_C6_CONNECT_TEST

        config GPSP_C6_CONNECT_PASSWORD
            string "Hosted STA test password"
            default ""
            depends on GPSP_C6_CONNECT_TEST

        config GPSP_C6_CONNECT_TIMEOUT_MS
            int "Hosted STA connect timeout (ms)"
            default 15000
            range 1000 600000
            depends on GPSP_C6_CONNECT_TEST

        config GPSP_C6_CONNECT_MAX_RETRIES
            int "Hosted STA connect retries"
            default 5
            range 1 20
            depends on GPSP_C6_CONNECT_TEST

        config GPSP_C6_HEALTH_LOG_PERIOD_MS
            int "ESP32-C6 health log period (ms)"
            default 10000
            range 1000 60000
            depends on GPSP_ENABLE_C6_REMOTE
            help
                Period for the background connectivity task to log that the
                remote C6 control path is still alive.
    endmenu

    menu "Netplay"
        config GPSP_NETPLAY_UDP_ENABLE
            bool "Enable host-side UDP netpacket transport"
            default n
            depends on GPSP_ENABLE_C6_REMOTE
            help
                Run gpsp multiplayer transport entirely on the ESP32-P4 host.
                The ESP32-C6 only provides the remote Wi-Fi stack; it no longer
                carries gpsp netpacket payloads. Peers discover each other over
                LAN broadcast and deterministically sort themselves into a
                continuous client_id roster at runtime.

        config GPSP_NETPLAY_UDP_PORT
            int "Netplay UDP port"
            default 60999
            range 1024 65535
            depends on GPSP_NETPLAY_UDP_ENABLE

        config GPSP_NETPLAY_BROADCAST_ADDR
            string "Netplay broadcast address"
            default "255.255.255.255"
            depends on GPSP_NETPLAY_UDP_ENABLE
            help
                Broadcast address used to flood netpacket frames on the local
                network. If your router blocks limited broadcast, set this to
                your subnet broadcast address, for example 192.168.1.255.

        config GPSP_NETPLAY_PEER_TIMEOUT_MS
            int "Peer timeout (ms)"
            default 2000
            range 100 30000
            depends on GPSP_NETPLAY_UDP_ENABLE
            help
                Time without inbound packets before a peer is removed from the
                active peer list and deducted from netplay_num_clients.

        config GPSP_NETPLAY_HELLO_INTERVAL_MS
            int "Roster hello interval (ms)"
            default 250
            range 50 5000
            depends on GPSP_NETPLAY_UDP_ENABLE
            help
                Interval for the runtime client_id election heartbeat. Every
                node periodically broadcasts a hello, and all nodes sort the
                visible participants with the same rule to obtain unique and
                continuous client ids.

    endmenu

endmenu
```

## sdkconfig.defaults
```kconfig
# ESP32-P4 SDK configuration defaults for gpsp
# Target board: JC4880P443C_I_W

# Target
CONFIG_IDF_TARGET="esp32p4"

# Flash
CONFIG_ESPTOOLPY_FLASHSIZE_16MB=y
CONFIG_ESPTOOLPY_FLASHMODE_QIO=y
CONFIG_ESPTOOLPY_FLASHFREQ_80M=y

# PSRAM (OPI 200MHz)
CONFIG_SPIRAM=y
CONFIG_SPIRAM_MODE_OCT=y
CONFIG_SPIRAM_SPEED_200M=y
CONFIG_SPIRAM_BOOT_INIT=y
CONFIG_SPIRAM_ALLOW_BSS_SEG_EXTERNAL_MEMORY=y
CONFIG_SPIRAM_ALLOW_STACK_EXTERNAL_MEMORY=y

# Partition table
CONFIG_PARTITION_TABLE_CUSTOM=y
CONFIG_PARTITION_TABLE_CUSTOM_FILENAME="partitions.csv"

# CPU frequency (400 MHz)
CONFIG_ESP_DEFAULT_CPU_FREQ_MHZ_400=y
CONFIG_ESP_DEFAULT_CPU_FREQ_MHZ=400

# FreeRTOS
CONFIG_FREERTOS_HZ=1000
CONFIG_FREERTOS_UNICORE=n

# Task watchdog - extend for emulation
CONFIG_ESP_TASK_WDT_TIMEOUT_S=30

# Compiler options
CONFIG_COMPILER_OPTIMIZATION_PERF=y

# Cache configuration - maximize for display and emulation
CONFIG_CACHE_L2_CACHE_SIZE_256KB=y
CONFIG_CACHE_L2_CACHE_LINE_SIZE_64B=y

# FAT filesystem for ROM loading from SD card
CONFIG_FATFS_LONG_FILENAMES=y
CONFIG_FATFS_LFN_HEAP=y
CONFIG_FATFS_MAX_LFN=255

# SDMMC
CONFIG_SOC_SDMMC_HOST_SUPPORTED=y

# I2C for ES8311 codec + GT911 touch
CONFIG_I2C_ISR_IRAM_SAFE=y

# LCD ST7701 panel type
CONFIG_BSP_LCD_TYPE_1024_600=y

# ESP32-C6 remote connectivity defaults
# Derived from the vendor xiaozhi-esp32 ESP32-P4 example.
CONFIG_ESP_HOSTED_ENABLED=y
CONFIG_ESP_HOSTED_P4_DEV_BOARD_NONE=y
CONFIG_ESP_HOSTED_SDIO_HOST_INTERFACE=y
CONFIG_ESP_HOSTED_IDF_SLAVE_TARGET="esp32c6"
CONFIG_ESP_HOSTED_SDIO_RESET_ACTIVE_HIGH=y
CONFIG_ESP_HOSTED_SDIO_OPTIMIZATION_RX_STREAMING_MODE=y
CONFIG_ESP_HOSTED_SDIO_SLOT_1=y
CONFIG_ESP_HOSTED_SDIO_4_BIT_BUS=y
CONFIG_ESP_HOSTED_SDIO_CLOCK_FREQ_KHZ=40000
CONFIG_ESP_HOSTED_SDIO_GPIO_RESET_SLAVE=54
CONFIG_ESP_HOSTED_SDIO_PIN_CMD=19
CONFIG_ESP_HOSTED_SDIO_PIN_CLK=18
CONFIG_ESP_HOSTED_SDIO_PIN_D0=14
CONFIG_ESP_HOSTED_SDIO_PIN_D1=15
CONFIG_ESP_HOSTED_SDIO_PIN_D2=16
CONFIG_ESP_HOSTED_SDIO_PIN_D3=17
CONFIG_ESP_HOSTED_SDIO_TX_Q_SIZE=20
CONFIG_ESP_HOSTED_SDIO_RX_Q_SIZE=20
CONFIG_ESP_WIFI_REMOTE_ENABLED=y
CONFIG_SLAVE_IDF_TARGET_ESP32C6=y
CONFIG_ESP_WIFI_REMOTE_LIBRARY_HOSTED=y

# gpSP dynarec defaults for ESP32-P4
CONFIG_GPSP_DYNAREC=y
CONFIG_GPSP_SMALL_TRANSLATION_CACHE=y
```
